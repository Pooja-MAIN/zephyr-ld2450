## drivers/sensor/hilink/Kconfig
```kconfig
# SPDX-FileCopyrightText: Copyright The Zephyr Project Contributors
# SPDX-License-Identifier: Apache-2.0

rsource "ld2450/Kconfig"
```

## drivers/sensor/hilink/ld2450/Kconfig
```kconfig
# SPDX-FileCopyrightText: Copyright The Zephyr Project Contributors
# SPDX-License-Identifier: Apache-2.0

config LD2450
	bool "Hi-Link LD2450 24GHz multi-target tracking radar"
	default y
	depends on DT_HAS_HILINK_LD2450_ENABLED
	depends on UART_INTERRUPT_DRIVEN
	help
	  Enable driver for the Hi-Link LD2450 UART radar, which reports the
	  position and speed of up to three targets.

config LD2450_UART_TIMEOUT_MS
	int "Report frame timeout in milliseconds"
	default 300
	depends on LD2450
	help
	  Maximum time sample_fetch() waits for the next complete report frame.
```

## dts/bindings/sensor/hilink,ld2450.yaml
```yaml
# SPDX-FileCopyrightText: Copyright The Zephyr Project Contributors
# SPDX-License-Identifier: Apache-2.0

description: |
  Hi-Link LD2450 24 GHz mmWave multi-target tracking radar.

  The sensor reports the position and speed of up to three targets over
  UART. Its factory default baud rate is 256000.

  Example:

    &uart1 {
      status = "okay";
      current-speed = <256000>;

      ld2450: ld2450 {
        compatible = "hilink,ld2450";
      };
    };

compatible: "hilink,ld2450"

include: [sensor-device.yaml, uart-device.yaml]
```

## tests/drivers/sensor/ld2450/testcase.yaml
```yaml
tests:
  drivers.sensor.ld2450:
    tags:
      - drivers
      - sensors
    platform_allow:
      - native_sim
      - native_sim/native/64
    integration_platforms:
      - native_sim/native/64
```
